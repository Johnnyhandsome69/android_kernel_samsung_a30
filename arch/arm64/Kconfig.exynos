## arch/arm64/Kconfig.exynos
```kconfig
config MACH_EXYNOS7904_A30_GLOBAL
	bool "Build DTBO img for A30"
	depends on SOC_EXYNOS7885
	default n
	help
	Say Y here if you want to enable building dtbo for galaxy A30.
```
